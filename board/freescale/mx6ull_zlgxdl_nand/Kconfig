## board/freescale/mx6ull_zlgxdl_nand/Kconfig
```kconfig
if TARGET_MX6ULL_ZLGXDL_NAND 

config SYS_BOARD
	default "mx6ull_zlgxdl_nand"

config SYS_VENDOR
	default "freescale"

config SYS_CONFIG_NAME
	default "mx6ull_zlgxdl_nand"

endif
```
